## kernel/Kconfig
```kconfig
menu "LunexSU"

config KSU
	tristate "LunexSU function support"
	depends on KPROBES && EXT4_FS
	default y
	help
	  Enable kernel-level root privileges on Android System.
	  Requires CONFIG_KPROBES for kernel hooking support.
	  Requires CONFIG_EXT4_FS for `ext4_unregister_sysfs`.
	  To compile as a module, choose M here: the
	  module will be called kernelsu.

config KSU_DEBUG
	bool "LunexSU debug mode"
	depends on KSU
	default n
	help
	  Enable LunexSU debug mode.

config KSU_DISABLE_MANAGER
	bool "Disable LunexSU manager integration"
	depends on KSU
	default n
	help
	  Disable manager APK detection and manager-specific handling.
	  Root will be used in place of manager-only functionality.

config KSU_DISABLE_POLICY
	bool "Disable LunexSU policy profiles"
	depends on KSU
	default n
	help
	  Disable per-app root/non-root profile customization.
	  Escalation will always use the default full root profile, and
	  non-root handling will follow the global umount policy only.

config KSU_X86_PATCH_SYSCALL_DISPATCHER
	bool "Dynamically patch x64's hardened syscall dispatcher to support syscall hooks"
	depends on KSU && X86_64
	default n
	help
	  Dynamically patch x64's hardened syscall dispatcher to support syscall hooks. This is a
	  replacement for a kernel source code patch, and is useful for x86_64 LKM mode.
	  This mode pins the module until reboot: its global C syscall entry wrappers
	  can remain on sleeping syscall stacks, including the unloading task itself.
	  Use the kernel indirect syscall bypass patch for an unloadable x86_64 LKM.

endmenu
```
